## Kconfig
```kconfig
# Copyright (c) 2022 GreenWaves Technologies SAS
# All rights reserved.
#
# Redistribution and use in source and binary forms, with or without
# modification, are permitted provided that the following conditions are met:
#
# 1. Redistributions of source code must retain the above copyright notice,
#    this list of conditions and the following disclaimer.
# 2. Redistributions in binary form must reproduce the above copyright
#    notice, this list of conditions and the following disclaimer in the
#    documentation and/or other materials provided with the distribution.
# 3. Neither the name of GreenWaves Technologies SAS nor the names of its
#    contributors may be used to endorse or promote products derived from
#    this software without specific prior written permission.
#
# THIS SOFTWARE IS PROVIDED BY THE COPYRIGHT HOLDERS AND CONTRIBUTORS "AS IS"
# AND ANY EXPRESS OR IMPLIED WARRANTIES, INCLUDING, BUT NOT LIMITED TO, THE
# IMPLIED WARRANTIES OF MERCHANTABILITY AND FITNESS FOR A PARTICULAR PURPOSE
# ARE DISCLAIMED. IN NO EVENT SHALL THE COPYRIGHT OWNER OR CONTRIBUTORS BE
# LIABLE FOR ANY DIRECT, INDIRECT, INCIDENTAL, SPECIAL, EXEMPLARY, OR
# CONSEQUENTIAL DAMAGES (INCLUDING, BUT NOT LIMITED TO, PROCUREMENT OF
# SUBSTITUTE GOODS OR SERVICES; LOSS OF USE, DATA, OR PROFITS; OR BUSINESS
# INTERRUPTION) HOWEVER CAUSED AND ON ANY THEORY OF LIABILITY, WHETHER IN
# CONTRACT, STRICT LIABILITY, OR TORT (INCLUDING NEGLIGENCE OR OTHERWISE)
# ARISING IN ANY WAY OUT OF THE USE OF THIS SOFTWARE, EVEN IF ADVISED OF THE
# POSSIBILITY OF SUCH DAMAGE.

menu "VWW App Menu"

    comment "Options"

    choice MODE
        prompt "Application Mode"
        config INFERENCE
            bool "INFERENCE Mode: just test the model"
            select LIB_GAP_LIB
			select LIB_GAP_LIB_IMG_IO

        config DEMO
            bool "Demo Mode: use the camera"
            select PLATFORM_BOARD
            select DRIVER_TYPE_CAMERA
            select DRIVER_OV5647

    endchoice

    choice NN_ARCHITECTURE
        prompt "NN Architecture"

        config MOBILENET
            bool "MOBILENET"

        config MIT_PROXYLESSNAS
            bool "MIT_PROXYLESSNAS"

    endchoice

    config INFERENCE_RESIZER
    	depends on INFERENCE
        bool "Insert resizer also in the INFERENCE"
        default y

endmenu
source "$(GAP_SDK_HOME)/utils/kconfig/Kconfig"
```
